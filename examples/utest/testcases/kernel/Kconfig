## examples/utest/testcases/kernel/Kconfig
```kconfig
menu "Kernel Testcase"

config UTEST_MEMHEAP_TC
    bool "memheap stability test"
    default y
    depends on RT_USING_MEMHEAP

config UTEST_IRQ_TC
    bool "IRQ test"
    default n

config UTEST_SEMAPHORE_TC
    bool "semaphore test"
    default n
    depends on RT_USING_SEMAPHORE

config UTEST_EVENT_TC
    bool "event test"
    default n
    depends on RT_USING_EVENT

config UTEST_TIMER_TC
    bool "timer test"
    default n

config UTEST_MESSAGEQUEUE_TC
    bool "message queue test"
    default n

config UTEST_SIGNAL_TC
    bool "signal test"
    default n
    depends on RT_USING_SIGNALS

config UTEST_MUTEX_TC
    bool "mutex test"
    default n

config UTEST_MAILBOX_TC
    bool "mailbox test"
    default n

config UTEST_THREAD_TC
    bool "thread test"
    default n

config UTEST_MEMPOOL_TC
    bool "memory pool test"
    default n
    depends on RT_USING_MEMPOOL

config UTEST_LIBC_SPRINTF_TC
    bool "kservice sprintf test"
    default n
    depends on RT_KSERVICE_USING_STDLIB

config UTEST_OBJECT_TC
    bool "object test"
    default n


endmenu
```
